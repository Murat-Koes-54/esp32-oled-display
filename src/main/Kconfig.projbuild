## src/main/Kconfig.projbuild
```kconfig
menu "OLED Display Config"

    menu "sensors config"
        config I2C0_PIN_SDA
            int "I2C0_PIN_SDA GPIO number"
            range 0 43 if IDF_TARGET_ESP32S3
            default 8 if IDF_TARGET_ESP32S3
            help
                GPIO number (IOxx) I2C0_PIN_SDA

        config I2C0_PIN_SCL
            int "I2C0_PIN_SCL GPIO number"
            range 0 43 if IDF_TARGET_ESP32S3
            default 9 if IDF_TARGET_ESP32S3
            help
                GPIO number (IOxx) I2C0_PIN_SCL
    endmenu

endmenu
```
